## meta-cnc/conf/layer.conf
```bitbake
# We have a conf and classes directory, add to BBPATH
BBPATH .= ":${LAYERDIR}"

# We have a recipes directory, add to BBFILES
BBFILES += "${LAYERDIR}/recipes*/*/*.bb \
    ${LAYERDIR}/recipes*/*/*.bbappend \
    ${LAYERDIR}/classes/*.bbclass"


BBFILE_COLLECTIONS += "cnc-layer"
BBFILE_PATTERN_cnc-layer = "^${LAYERDIR}/"
BBFILE_PRIORITY_cnc-layer = "6"
```
